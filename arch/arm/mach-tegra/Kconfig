## arch/arm/mach-tegra/Kconfig
```kconfig
# Copyright (c) 2012, NVIDIA CORPORATION.  All rights reserved.
#
# This program is free software; you can redistribute it and/or modify it
# under the terms and conditions of the GNU General Public License,
# version 2, as published by the Free Software Foundation.
#
# This program is distributed in the hope it will be useful, but WITHOUT
# ANY WARRANTY; without even the implied warranty of MERCHANTABILITY or
# FITNESS FOR A PARTICULAR PURPOSE.  See the GNU General Public License for
# more details.
#
# You should have received a copy of the GNU General Public License
# along with this program.  If not, see <http://www.gnu.org/licenses/>.

if ARCH_TEGRA

comment "NVIDIA Tegra options"

config ARCH_TEGRA_2x_SOC
	bool "Tegra 2 family SOC"
	default y
	depends on !ARCH_TEGRA_3x_SOC
	select ARCH_TEGRA_HAS_PCIE
	select CPU_V7
	select ARM_GIC
	select ARM_SAVE_DEBUG_CONTEXT if PM_SLEEP
	select ARCH_REQUIRE_GPIOLIB
	select USB_ARCH_HAS_EHCI if USB_SUPPORT
	select USB_ULPI if USB_SUPPORT
	select USB_ULPI_VIEWPORT if USB_SUPPORT
	select ARM_ERRATA_742230 if SMP
	select USB_ARCH_HAS_EHCI if USB_SUPPORT
	select USB_ULPI if USB_SUPPORT
	select USB_ULPI_VIEWPORT if USB_SUPPORT
	select ARCH_SUPPORTS_MSI if TEGRA_PCI
	select PCI_MSI if TEGRA_PCI
	select CPA
	select ARM_ERRATA_716044
	select ARM_ERRATA_764369 if SMP
	select ARCH_HAS_SUSPEND_PAGETABLE
	select NVMAP_CACHE_MAINT_BY_SET_WAYS
	help
	  Support for NVIDIA Tegra AP20 and T20 processors, based on the
	  ARM CortexA9MP CPU and the ARM PL310 L2 cache controller

config ARCH_TEGRA_3x_SOC
	bool "Tegra 3 family SOC"
	select ARCH_TEGRA_HAS_PCIE
	select ARCH_TEGRA_HAS_SATA
	select ARCH_TEGRA_HAS_DUAL_3D
	select ARCH_TEGRA_HAS_DUAL_CPU_CLUSTERS
	select CPU_V7
	select ARM_GIC
	select ARM_SAVE_DEBUG_CONTEXT if PM_SLEEP
	select GIC_SET_MULTIPLE_CPUS if SMP
	select ARCH_REQUIRE_GPIOLIB
	select USB_ARCH_HAS_EHCI if USB_SUPPORT
	select USB_EHCI_TEGRA if USB_SUPPORT
	select USB_ULPI if USB_SUPPORT
	select USB_ULPI_VIEWPORT if USB_SUPPORT
	select REPORT_PRESENT_CPUS if TEGRA_AUTO_HOTPLUG
	select ARCH_SUPPORTS_MSI if TEGRA_PCI
	select PCI_MSI if TEGRA_PCI
	select ARM_ERRATA_754322
	select ARM_ERRATA_764369 if SMP
	select TEGRA_LP2_ARM_TWD if HAVE_ARM_TWD && !TEGRA_RAIL_OFF_MULTIPLE_CPUS
	select CPA
	select ARCH_HAS_SUSPEND_PAGETABLE
	select NVMAP_CACHE_MAINT_BY_SET_WAYS
	help
	  Support for NVIDIA Tegra 3 family of SoCs, based upon the
	  ARM CortexA9MP CPU and the ARM PL310 L2 cache controller

config ARCH_TEGRA_HAS_DUAL_3D
	bool

config ARCH_TEGRA_HAS_DUAL_CPU_CLUSTERS
	bool

config ARCH_TEGRA_HAS_PCIE
	bool

config ARCH_TEGRA_HAS_SATA
	bool

config TEGRA_PCI
	bool "PCIe host controller driver"
	select PCI
	depends on ARCH_TEGRA_HAS_PCIE
	help
	  Adds PCIe Host controller driver for tegra based systems

comment "Tegra board type"

config MACH_HARMONY
       bool "Harmony board"
       depends on ARCH_TEGRA_2x_SOC
       select MACH_HAS_SND_SOC_TEGRA_WM8903 if SND_SOC
       help
         Support for NVIDIA Harmony development platform

config MACH_VENTANA
       bool "Ventana board"
       depends on ARCH_TEGRA_2x_SOC
       select MACH_HAS_SND_SOC_TEGRA_WM8903 if SND_SOC
       help
         Support for NVIDIA Ventana development platform

config MACH_KAEN
       bool "Kaen board"
       depends on ARCH_TEGRA_2x_SOC
       select MACH_SEABOARD
       select MACH_HAS_SND_SOC_TEGRA_WM8903 if SND_SOC
       help
         Support for the Kaen version of Seaboard

config MACH_PAZ00
       bool "Paz00 board"
       depends on ARCH_TEGRA_2x_SOC
       help
         Support for the Toshiba AC100/Dynabook AZ netbook

config MACH_SEABOARD
       bool "Seaboard board"
       depends on ARCH_TEGRA_2x_SOC
       select MACH_HAS_SND_SOC_TEGRA_WM8903 if SND_SOC
       help
         Support for nVidia Seaboard development platform. It will
	 also be included for some of the derivative boards that
	 have large similarities with the seaboard design.

config MACH_TEGRA_DT
	bool "Generic Tegra board (FDT support)"
	select USE_OF
	help
	  Support for generic nVidia Tegra boards using Flattened Device Tree

config MACH_TRIMSLICE
       bool "TrimSlice board"
       depends on ARCH_TEGRA_2x_SOC
       select TEGRA_PCI
       help
         Support for CompuLab TrimSlice platform

config MACH_WARIO
       bool "Wario board"
       depends on ARCH_TEGRA_2x_SOC
       select MACH_SEABOARD
       help
         Support for the Wario version of Seaboard

config MACH_WHISTLER
       bool "Whistler board"
       depends on ARCH_TEGRA_2x_SOC
       select MACH_HAS_SND_SOC_TEGRA_WM8753 if SND_SOC
       select MACH_HAS_SND_SOC_TEGRA_TLV320AIC326X if SND_SOC
       help
         Support for NVIDIA Whistler development platform

config MACH_ARUBA
       bool "Aruba board"
       depends on ARCH_TEGRA_3x_SOC
       select TEGRA_FPGA_PLATFORM
       help
         Support for NVIDIA Aruba2 FPGA development platform

config MACH_CARDHU
       bool "Cardhu board"
       depends on ARCH_TEGRA_3x_SOC
       select MACH_HAS_SND_SOC_TEGRA_WM8903 if SND_SOC
       select MACH_HAS_SND_SOC_TEGRA_TLV320AIC326X if SND_SOC
       select MACH_HAS_SND_SOC_TEGRA_MAX98095 if SND_SOC
       help
         Support for NVIDIA Cardhu development platform

config MACH_P1852
       bool "P1852 board"
       depends on ARCH_TEGRA_3x_SOC
       help
         Support for NVIDIA P1852 development platform

config MACH_TEGRA_ENTERPRISE
       bool "Enterprise board"
       depends on ARCH_TEGRA_3x_SOC
       select MACH_HAS_SND_SOC_TEGRA_MAX98088 if SND_SOC
       select MACH_HAS_SND_SOC_TEGRA_TLV320AIC326X if SND_SOC
       select TEGRA_SLOW_CSITE
       help
         Support for NVIDIA Enterprise development platform

config MACH_KAI
       bool "Kai board"
       depends on ARCH_TEGRA_3x_SOC
       select MACH_HAS_SND_SOC_TEGRA_RT5639 if SND_SOC
       select MACH_HAS_SND_SOC_TEGRA_RT5640 if SND_SOC
       help
         Support for NVIDIA KAI development platform

config BATTERY_TPS80032
       bool "HTC battery driver for tps80032"
       depends on HTC_BATT_CORE && ADC_TPS80032 && VSYS_ALARM_TPS80032

config HTC_BATT_CORE
	depends on POWER_SUPPLY
	bool "HTC battery core driver"

config HTC_POWER_OFF
       bool "HTC Power Off"
       help
          Switch power off to reboot if cable attached

config HTC_PROJECT
       bool "HTC Project"
       select HTC_DEBUG_FILE_NODE
       select WATCHDOG
       select TEGRA_WATCHDOG
       select TEGRA_WATCHDOG_ENABLE_ON_PROBE
       select BOOTPARAM_SOFTLOCKUP_PANIC
       select ANDROID_RAM_CONSOLE_APPEND_PMIC_STATUS_BITS
       select DEBUG_MUTEXES
       select HTC_POWER_OFF
       help
         HTC Project

config MACH_ENDEAVORU
       bool "ENDEAVORU board"
       depends on ARCH_TEGRA_3x_SOC
       depends on HTC_PROJECT
       select MACH_HAS_SND_SOC_TEGRA_MAX98088 if SND_SOC
       select MACH_HAS_SND_SOC_TEGRA_TLV320AIC326X if SND_SOC
       select TEGRA_SLOW_CSITE
       select VIDEO_CHANGE_IN_AD5823
       select RAWCHIP_ENABLE
       select TEGRA_CPU_AP33
       help
         Support for HTC Endeavor#U platform
         jj
config MACH_ENDEAVORTD
       bool "ENDEAVORTD board"
       depends on ARCH_TEGRA_3x_SOC
       depends on HTC_PROJECT
       select MACH_HAS_SND_SOC_TEGRA_MAX98088 if SND_SOC
       select MACH_HAS_SND_SOC_TEGRA_TLV320AIC326X if SND_SOC
       select TEGRA_SLOW_CSITE
       select VIDEO_CHANGE_IN_AD5823
       select RAWCHIP_ENABLE
       select TEGRA_CPU_AP33
       help
         Support for HTC Endeavor#TD platform

config MACH_ENRC2U
       bool "EndeavorC2#U board"
       depends on ARCH_TEGRA_3x_SOC
       depends on HTC_PROJECT
       select MACH_HAS_SND_SOC_TEGRA_MAX98088 if SND_SOC
       select MACH_HAS_SND_SOC_TEGRA_TLV320AIC326X if SND_SOC
       select TEGRA_SLOW_CSITE
       select VIDEO_CHANGE_IN_AD5823
       select RAWCHIP_ENABLE
       select RAWCHIP_ENABLE_FRONT
       help
         Support for HTC EndeavorC2#U platform

config MACH_ENRC2B
       bool "EndeavorC2#U board"
       depends on ARCH_TEGRA_3x_SOC
       depends on HTC_PROJECT
       select MACH_HAS_SND_SOC_TEGRA_MAX98088 if SND_SOC
       select MACH_HAS_SND_SOC_TEGRA_TLV320AIC326X if SND_SOC
       select TEGRA_SLOW_CSITE
       select VIDEO_CHANGE_IN_AD5823
       select RAWCHIP_ENABLE
       select RAWCHIP_ENABLE_FRONT
       help
         Support for HTC EndeavorC2#B platform

config MACH_EVITAREUL
       bool "EvitaRE#UL board"
       depends on ARCH_TEGRA_3x_SOC
       depends on HTC_PROJECT
       select MACH_HAS_SND_SOC_TEGRA_MAX98088 if SND_SOC
       select MACH_HAS_SND_SOC_TEGRA_TLV320AIC326X if SND_SOC
       select TEGRA_SLOW_CSITE
       select VIDEO_CHANGE_IN_AD5823
       select RAWCHIP_ENABLE
       select RAWCHIP_ENABLE_FRONT
       select QCT_9K_MODEM
       help
         Support for HTC EvitaRE#UL platform

config MACH_OPERAUL
       bool "Opera#UL board"
       depends on ARCH_TEGRA_3x_SOC
       depends on HTC_PROJECT
       select MACH_HAS_SND_SOC_TEGRA_MAX98088 if SND_SOC
       select MACH_HAS_SND_SOC_TEGRA_TLV320AIC326X if SND_SOC
       select TEGRA_SLOW_CSITE
       select VIDEO_CHANGE_IN_AD5823
       select RAWCHIP_ENABLE
       select RAWCHIP_ENABLE_FRONT
       select QCT_9K_MODEM
       select SENSORS_CAPSENSE_HSNR
       help
         Support for HTC Opera#UL platform

choice
       prompt "Tegra cpu family"
       default TEGRA_CPU_AP37

config TEGRA_CPU_AP33
       bool "AP33/1.5GHz"
       depends on MACH_ENDEAVORU || MACH_ENDEAVORTD

config TEGRA_CPU_AP37
       bool "AP37/1.7GHz"
       depends on MACH_ENRC2B || MACH_ENRC2U || MACH_EVITAREUL

endchoice

choice
       prompt "Tegra platform type"
       default TEGRA_SILICON_PLATFORM

config TEGRA_SILICON_PLATFORM
        bool "Silicon"
        help
          This enables support for a Tegra silicon platform.

config TEGRA_SIMULATION_PLATFORM
        bool "Simulation"
        help
          This enables support for a Tegra simulation platform.
          Select this only if you are an NVIDIA developer working
          on a simulation platform.

config TEGRA_FPGA_PLATFORM
        bool "FPGA"
        help
          This enables support for a Tegra FPGA platform.
          Select this only if you are an NVIDIA developer working
          on a FPGA platform.
endchoice

source "arch/arm/mach-tegra/p852/Kconfig"

choice
        prompt "Low-level debug console UART"
        default TEGRA_DEBUG_UART_NONE

config TEGRA_DEBUG_UART_NONE
        bool "None"

config TEGRA_DEBUG_UARTA
        bool "UART-A"
	depends on DEBUG_LL

config TEGRA_DEBUG_UARTB
        bool "UART-B"
	depends on DEBUG_LL

config TEGRA_DEBUG_UARTC
        bool "UART-C"
	depends on DEBUG_LL

config TEGRA_DEBUG_UARTD
        bool "UART-D"
	depends on DEBUG_LL

config TEGRA_DEBUG_UARTE
        bool "UART-E"
	depends on DEBUG_LL
endchoice

config TEGRA_SYSTEM_DMA
	bool "Enable system DMA driver for NVIDIA Tegra SoCs"
	default y
	help
	  Adds system DMA functionality for NVIDIA Tegra SoCs, used by
	  several Tegra device drivers

config TEGRA_PWM
	tristate "Enable PWM driver"
	select HAVE_PWM
	help
	  Enable support for the Tegra PWM controller(s).

config TEGRA_FIQ_DEBUGGER
	bool "Enable the FIQ serial debugger on Tegra"
	default n
	select FIQ_DEBUGGER
	help
	  Enables the FIQ serial debugger on Tegra

config TEGRA_P1852_TDM
	bool "Enable TDM mode for P1852 SKUs"
	default n
	depends on MACH_P1852
	help
		Enables TDM mode driver for P1852 SKUs. If this
		is not defined then I2S mode is selected by default.

config TEGRA_CARDHU_DSI
	bool "Support DSI panel on Cardhu"
	depends on MACH_CARDHU
	select TEGRA_DSI
	help
		Support for DSI Panel on Nvidia Cardhu

config TEGRA_CARDHU_DUAL_DSI_PANEL
	bool "Support Dual DSI panel on Cardhu"
	default n
	depends on TEGRA_CARDHU_DSI
	help
		Support for Dual DSI Panel on Nvidia Cardhu

config TEGRA_EMC_SCALING_ENABLE
	bool "Enable scaling the memory frequency"
	depends on TEGRA_SILICON_PLATFORM
	default n

config TEGRA_CPU_DVFS
	bool "Enable voltage scaling on Tegra CPU"
	depends on TEGRA_SILICON_PLATFORM
	default y

config TEGRA_CORE_DVFS
	bool "Enable voltage scaling on Tegra core"
	depends on TEGRA_SILICON_PLATFORM
	depends on TEGRA_CPU_DVFS
	default y

config TEGRA_IOVMM_GART
	bool "Enable I/O virtual memory manager for GART"
	depends on ARCH_TEGRA_2x_SOC && !TEGRA_IOMMU_GART
	default y
	select TEGRA_IOVMM
	help
	  Enables support for remapping discontiguous physical memory
	  shared with the operating system into contiguous I/O virtual
	  space through the GART (Graphics Address Relocation Table)
	  hardware included on Tegra SoCs.

config TEGRA_IOVMM_SMMU
	bool "Enable I/O virtual memory manager for SMMU"
	depends on ARCH_TEGRA_3x_SOC && !TEGRA_IOMMU_SMMU
	default y
	select TEGRA_IOVMM
	help
	  Enables support for remapping discontiguous physical memory
	  shared with the operating system into contiguous I/O virtual
	  space through the SMMU (System Memory Management Unit)
	  hardware included on Tegra SoCs.

config TEGRA_IOVMM_SMMU_SYSFS
	bool "Enable SMMU register access for debugging"
	depends on TEGRA_IOVMM_SMMU
	default n
	help
	  Enables SMMU register access through /sys/devices/smmu/* files.

config TEGRA_IOVMM
	depends on TEGRA_IOVMM_GART || TEGRA_IOVMM_SMMU
	bool

config TEGRA_AVP_KERNEL_ON_MMU
	bool "Use AVP MMU to relocate AVP kernel"
	depends on ARCH_TEGRA_2x_SOC
	default y
	help
	  Use AVP MMU to relocate AVP kernel (nvrm_avp.bin).

config TEGRA_AVP_KERNEL_ON_SMMU
	bool "Use SMMU to relocate AVP kernel"
	depends on TEGRA_IOVMM_SMMU || TEGRA_IOMMU_SMMU
	default y
	help
	  Use SMMU to relocate AVP kernel (nvrm_avp.bin).

config TEGRA_ARB_SEMAPHORE
	bool

config TEGRA_THERMAL_THROTTLE
	bool "Enable throttling of CPU speed on overtemp"
	depends on TEGRA_SILICON_PLATFORM
	depends on CPU_FREQ
	depends on THERMAL
	default y
	help
	  Also requires enabling a temperature sensor such as NCT1008.

config WIFI_CONTROL_FUNC
	bool "Enable WiFi control function abstraction"
	help
	  Enables Power/Reset/Carddetect function abstraction

config TEGRA_CLOCK_DEBUG_WRITE
	bool "Enable debugfs write access to clock tree"
	depends on DEBUG_FS
	default n

config TEGRA_CLUSTER_CONTROL
	bool
	depends on ARCH_TEGRA_HAS_DUAL_CPU_CLUSTERS
	default y if PM_SLEEP

config TEGRA_AUTO_HOTPLUG
	bool "Enable automatic CPU hot-plugging"
	depends on HOTPLUG_CPU && CPU_FREQ && !ARCH_CPU_PROBE_RELEASE && !ARCH_TEGRA_2x_SOC
	default y
	help
	  This option enables turning CPUs off/on and switching tegra
	  high/low power CPU clusters automatically, corresponding to
	  CPU frequency scaling.

config BEST_TRADE_HOTPLUG
	bool "Hotplug depends on power-performance tradeoff"
	depends on HOTPLUG_CPU && SMP
	default n
	help
	  This option enables making decision of CPU hotplug
	  bases on the tradeoff between power vs. performance.
	  A good trade would retain overall system performance,
	  as well as save battery life.


config TEGRA_MC_EARLY_ACK
	bool "Enable early acknowledgement from mermory controller"
	depends on ARCH_TEGRA_3x_SOC
	default y
	help
	  This option enables early acknowledgement from memory
	  controller. This feature is used to improve CPU memory
	  write performance.

config TEGRA_MC_PROFILE
	tristate "Enable profiling memory controller utilization"
	default y
	help
	  When enabled, provides a mechanism to perform statistical
	  sampling of the memory controller usage on a client-by-client
	  basis, and report the log through sysfs.

config TEGRA_EDP_LIMITS
	bool "Enforce electrical design limits"
	depends on TEGRA_SILICON_PLATFORM
	depends on CPU_FREQ
	default y if ARCH_TEGRA_3x_SOC
	default n
	help
	  Limit maximum CPU frequency based on temperature and number
	  of on-line CPUs to keep CPU rail current within power supply
	  capabilities.

config TEGRA_EMC_TO_DDR_CLOCK
	int "EMC to DDR clocks ratio"
	default "2" if ARCH_TEGRA_2x_SOC
	default "1"

config TEGRA_INTERACTIVE_GOV_ON_EARLY_SUSPEND
	bool "Use interactive cpu frequency governor when device enters early suspend"
	depends on HAS_EARLYSUSPEND && CPU_FREQ && !TEGRA_CONSERVATIVE_GOV_ON_EARLY_SUSPEND
	default y
	help
	 Also will restore to original cpu frequency governor when device is resumed

config TEGRA_SE_ON_CBUS
	bool "To Drive SE clock from cbus"
	default y
	help
	  This option enables SE clock to be derived from cbus

config TEGRA_CBUS_CLOCK_DIVIDER
        int "CBUS clock divider"
        default "2"

config TEGRA_CONVSERVATIVE_GOV_ON_EARLYSUPSEND
	bool "Use conservative cpu frequency governor when device enters early suspend"
	depends on HAS_EARLYSUSPEND && CPU_FREQ
	default n
	help
	 Also will restore to original cpu frequency governor when device is resumed

config TEGRA_STAT_MON
        bool "Enable H/W statistics monitor"
        depends on ARCH_TEGRA_2x_SOC
        default n
        help
          Enables support for hardware statistics monitor for AVP.

config USB_HOTPLUG
	bool "Enabling the USB hotplug"
	default n

config TEGRA_GADGET_BOOST_CPU_FREQ
	int "Boost cpu frequency for tegra usb gadget (0-1300 mhz)"
	range 0 1300
	default 0
	help
	  Devices need to boost frequency of CPU when they are connected
	  to host pc through usb cable for better performance. This value
	  is the amount of the frequency (in mhz) to be boosted. If it is
	  zero boosting frequency will not be enabled. This value will be
	  used only by usb gadget driver.

config TEGRA_DYNAMIC_PWRDET
	bool "Enable dynamic activation of IO level auto-detection"
	depends on TEGRA_SILICON_PLATFORM
	default n
	help
	  This option allows turning off tegra IO level auto-detection
	  when IO power is stable. If set auto-detection cells are active
	  only during power transitions, otherwise, the cells are active
	  always

config TEGRA_EDP_EXACT_FREQ
	bool "Use maximum possible cpu frequency when EDP capping"
	depends on TEGRA_EDP_LIMITS
	default y
	help
	  When enabled the cpu will run at the exact frequency
	  specified in the EDP table when EDP capping is applied; when
	  disabled the next lower cpufreq frequency will be used.

config TEGRA_USB_MODEM_POWER
	bool "Enable tegra usb modem power management"
	default n
	help
	  This option enables support for out-of_band remote wakeup, selective
	  suspend and system suspend/resume.

config TEGRA_BB_XMM_POWER
	bool "Enable power driver for XMM modem"
	default n
	help
	  Enables power driver which controls gpio signals to XMM modem.

config TEGRA_BB_XMM_POWER2
	tristate "Enable power driver for XMM modem (flashless)"
	default n
	help
	  Enables power driver which controls gpio signals to XMM modem
	  (in flashless configuration).  User-mode application must
	  insert this LKM to initiate 2nd USB enumeration power sequence
	  - after modem software has been downloaded to flashless device.

config HTC_SIMHOTSWAP
       bool "Enable sim hotswap driver for sim detect"
       default n
       help
         Enables sim hotswap driver for sim detect.

config REMOVE_HSIC_L3_STATE
	bool "Remove HSIC L3 suspend state"
	default n
	help
	  Remove HSIC L3 suspend state.

config HTC_HEADSET_MGR
	tristate "HTC headset manager driver"
	default n
	help
	  Provides support of HTC headset manager.

config HTC_HEADSET_H2W
	tristate "HTC 2 Wire headset driver"
	depends on HTC_HEADSET_MGR
	default n
	help
	  Provides support of HTC 2 Wire headset.

config HTC_HEADSET_GPIO
	tristate "HTC GPIO headset detection driver"
	depends on HTC_HEADSET_MGR
	default n
	help
	  Provides support of HTC GPIO headset detection.

config HTC_HEADSET_MICROP
	tristate "HTC Micro-P headset detection driver"
	depends on HTC_HEADSET_MGR && MICROP_COMMON
	default n
	help
	  Provides support of HTC Micro-P headset detection.

config HTC_HEADSET_PMIC
	tristate "HTC PMIC headset detection driver"
	depends on HTC_HEADSET_MGR
	default n
	help
	  Provides support of HTC PMIC headset detection.

config HTC_HEADSET_MISC
	tristate "HTC MISC headset detection driver"
	depends on HTC_HEADSET_MGR
	default n
	help
	  Provides support of HTC MISC headset detection.

config HTC_HEADSET_8X60
	tristate "HTC 8X60 headset detection driver"
	depends on HTC_HEADSET_MGR
	default n
	help
	  Provides support of HTC 8X60 headset detection.

config HTC_HEADSET_ONE_WIRE
	tristate "HTC 1-wire headset detection driver"
	depends on HTC_HEADSET_MGR
	default n
	help
	  Provides support of HTC 1-wire headset detection.

config RAWCHIP_ENABLE
    bool "Enable rawchip driver"
    default n

config RAWCHIP_ENABLE_FRONT
    bool "Enable rawchip driver for front camera"
    default n

config TEGRA_PLLM_RESTRICTED
	bool "Restrict PLLM usage as module clock source"
	depends on !ARCH_TEGRA_2x_SOC
	default n
	help
	  When enabled, PLLM usage may be restricted to modules with dividers
	  capable of dividing maximum PLLM frequency at minimum voltage. When
	  disabled, PLLM is used as a clock source with no restrictions (which
	  may effectively increase lower limit for core voltage).

config TEGRA_WDT_RECOVERY
	bool "Enable suspend/resume watchdog recovery mechanism"
	default n
	help
	  Enables watchdog recovery mechanism to protect against
	  suspend/resume hangs.

config ANDROID_RAM_CONSOLE_APPEND_PMIC_STATUS_BITS
	bool "Append PMIC status bits to end of /proc/last_kmsg"
	default n
	help
	  Append PMIC status bits to end of /proc/last_kmsg for
	  checking the boot / reset reason in detail

config TEGRA_LP2_ARM_TWD
	bool

config TEGRA_RAIL_OFF_MULTIPLE_CPUS
	bool

config TEGRA_SLOW_CSITE
	bool "lower csite clock to 1 Mhz to reduce its power consumption"
	default n
	help
	  When enabled, csite will be running at 1 Mhz and the performance of
	  jtag, lauterbach and other debugger will be extremely slow.

config TEGRA_PREINIT_CLOCKS
	bool "Preinitialize Tegra clocks to known states"
	default n
	help
	  Preinitialize Tegra clocks to known states before actual full-
	  scale clock initialization starts.

config TEGRA_PREPOWER_WIFI
	bool "Pre-power up WiFi "
	default n
	help
	  Pre-power up the on board WiFi chip

config HTC_USB_NOTIFIER
	tristate "HTC usb notifier register"
	default y
	help
	  If usb status are change, a usb notifier will callback to
	  registered function.
config MSM_SUBSYSTEM_RESTART
	bool "MSM Subsystem Restart Driver"
	default n
	help
	  This option enables the MSM subsystem restart driver, which provides
	  a framework to handle subsystem crashes.

config HTC_QCT_9K_MDM_HSIC_PM_DBG
	bool "HTC_QCT_9K_MDM_HSIC_PM_DBG"
	default n
	help
	  This option enables the HTC_QCT_9K_MDM_HSIC_PM_DBG log

config MSM_NONSMD_PACKET_FILTER
	bool "Non-SMD based Packet Filter"
	default n
	help
	  The white TCP port list is updated in attribute
	  repying on RIL to notify modem.

config LARGE_TCP_INITIAL_BUFFER
	bool "Large TCP initial Buffer"
	default n
	help
	  Enlarge TCP initial buffer size.

config QCT_9K_MODEM
	bool "Enable Qualcomm 9K modem"
	select MSM_RMNET_USB
	select USB_QCOM_DIAG_BRIDGE
	select USB_QCOM_MDM_BRIDGE
	select MSM_SUBSYSTEM_RESTART
	select USB_SERIAL_QUALCOMM
	select DIAG_CHAR
	select DIAG_OVER_USB
	select DIAG_HSIC_PIPE
	select USB_ANDROID_DIAG
	select USB_ANDROID_RMNET
	select MSM_RMNET_BAM
	select MODEM_SUPPORT
	select MSM_NONSMD_PACKET_FILTER
	select LARGE_TCP_INITIAL_BUFFER
	select HTC_QCT_9K_MDM_HSIC_PM_DBG
	help
	  Qualcomm 9K modem

config TEGRA_SKIN_THROTTLE
	bool "Skin Temperature throttling"
	depends on TEGRA_THERMAL_THROTTLE
	depends on THERM_EST
	default n
	help
	  Enable throttling to control the temperature of the skin/case
	  of the device.
endif

config RIL_FTRACE_DEBUG_SOCK_IOCTL
	bool "Enable ftrace debug for socket io-control"
	default n
	help
	  Debug for rmnet ioctl no response.

config SENSE_4_PLUS
	depends on ARCH_TEGRA_3x_SOC
	bool "SENSE 4 PLUS"
	help
	  Support for SENSE 4 PLUS.

config MEMORY_FOOTPRINT_DEBUGGING
	bool "footprint for debugging"
	default n
```
