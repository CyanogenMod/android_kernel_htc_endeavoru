## drivers/htc/Kconfig
```kconfig
config HTC_POWER_SUPPLY
	bool "HTC Power Supply"
	default n
	help
	  Use HTC Power Supply for a fake-able battery.

config PM_R_DEBUG
	bool "Print [R] when suspend"
	help
	  Print [R] when suspend
```

## drivers/i2c/chips/Kconfig
```kconfig
#
# Miscellaneous I2C chip drivers configuration
#
# *** DEPRECATED! Do not add new entries! See Makefile ***
#

menu "Miscellaneous I2C Chip support"


config SENSORS_BMA250
	tristate "BMA250 acceleration sensor support"
	depends on I2C=y
	help
	  BMA250 G-sensor Driver implemented by HTC.

config SENSORS_PANASONIC_GYRO
	tristate "PANASONIC GYRO sensor support"
	depends on I2C=y
	help
	  PANASONIC GYR Driver implemented by HTC.

config SENSORS_AKM8975_PANA_GYRO
        tristate "AKM8973 Compass Driver for Pana Gyro"
        depends on I2C
        help
         AKM8975 Compass Driver implemented by HTC.


config SENSORS_NFC_PN544
	tristate "PN544 NFC sensor support"
	depends on I2C=y
	help
	  PN544 NFC Driver implemented.

config SENSORS_BMA250
	tristate "BMA250 acceleration sensor support"
	depends on I2C=y
	help
	  BMA250 G-sensor Driver implemented by HTC.

config SENSORS_ONLY_BMA250
	tristate "BMA250 acceleration sensor support"
	depends on I2C=y
	help
	  BMA250 ONLY G-sensor Driver implemented by HTC.

config SENSORS_CAPSENSE_SAR
	tristate "CapSense SAR Driver"
	depends on I2C
	help
	CapSense SAR Sensor Driver implemented by HTC.

config SENSORS_CAPSENSE_HSNR
	tristate "Capsnese Holding Sensor"
	depends on I2C
	help
	CapSense Holding Sensor Driver implemented by HTC.

config INPUT_ISL29028
        tristate "ISL29028 proximity and light sensor"
        help
          Say Y here to enable the ISL29028 Short Distance Proximity
          Sensor with Ambient Light Sensor.

config INPUT_CAPELLA_CM3628
	tristate "CM3628 proximity and light sensor"
	default n
	help
	  Say Y here to enable the CM3628 Short Distance Proximity
	  Sensor with Ambient Light Sensor.

config INPUT_CAPELLA_CM3629
	tristate "CM3629 proximity and light sensor"
	default n
	help
	  Say Y here to enable the CM3629 Short Distance Proximity
	  Sensor with Ambient Light Sensor.

config INPUT_ISL29028_CM3628
	tristate "ISL29028(EVM) or CM3628(EVT) proximity and light sensor"
	default n
	help
	  Say Y here to enable the CM3628 Short Distance Proximity
	  Sensor with Ambient Light Sensor.

endmenu
```

## drivers/misc/htc/Kconfig
```kconfig
#
# Htc specific module
#

config HTC_DEBUG_FILE_NODE
	bool "HTC debug file node"
	default n
	help
	    add a file node for userspace to read / store debug flag

config LAST_BOOT_DEBUG
	bool "Last boot file node"
	default n
	help
	    to expose the debug information of last booting
```

## drivers/misc/mpu3050_htc/Kconfig
```kconfig
menu "Motion Sensors Support"


config MPU_SENSORS_MPU3050_HTC
    tristate "MPU3050"
    help
      If you say yes here you get support for the MPU3050 Gyroscope driver
      This driver can also be built as a module.  If so, the module
      will be called mpu3050.


choice
    prompt "Accelerometer Type"
    depends on MPU_SENSORS_MPU3050_HTC
    default MPU_SENSORS_BMA250_HTC

config MPU_SENSORS_KXTF9_HTC
    bool "Kionix KXTF9"
    help
      This enables support for the Kionix KXFT9 accelerometer

config MPU_SENSORS_BMA250_HTC
    bool "Bosch BMA250"
    depends on MPU_SENSORS_MPU3050_HTC
    help
      This enables support for the Bosch BMA250 accelerometer

endchoice



choice
    prompt "Compass Type"
    depends on MPU_SENSORS_MPU6000 || MPU_SENSORS_MPU3050_HTC
    optional

config MPU_SENSORS_AK8975_HTC
    bool "AKM ak8975"
    help
      This enables support for the AKM ak8975 compass

endchoice

config MPU_SENSORS_TIMERIRQ_HTC
    tristate "Timer IRQ"
    help
    If you say yes here you get access to the timerirq device handle which
    can be used to select on. This can be used instead of IRQ's, sleeping,
    or timer threads. Reading from this device returns the same type of
    information as reading from the MPU and slave IRQ's.

config MPU_SENSORS_DEBUG_HTC
    bool "MPU debug"
    depends on MPU_SENSORS_MPU3050_HTC || MPU_SENSORS_MPU6000 || MPU_SENSORS_TIMERIRQ_HTC
    help
      If you say yes here you get extra debug messages from the MPU3050
      and other slave sensors.

endmenu
```

## drivers/misc/ts27010mux_usb/Kconfig
```kconfig
#
# TS 27.010 configuration
#

menu "Motorola TS 27.010 Mux driver over USB"

config MOT_FEAT_TS27010MUX_USB
        tristate "Motorola TS 27.010 Mux driver over USB"
        default n

endmenu
```

## drivers/staging/ti-st/Kconfig
```kconfig
#
# TI's shared transport line discipline and the protocol
# drivers (BT, FM and GPS)
#
menu "Texas Instruments shared transport line discipline"
config ST_FM
	tristate "fm driver for ST"
	depends on VIDEO_DEV
	select TI_ST
	help
	  This enables the FM driver for TI BT/FM/GPS combo devices
	  This makes use of shared transport line discipline core driver to
	  communicate with the FM core of the combo chip.
endmenu
```

## drivers/video/tegra/sii9234/Kconfig
```kconfig
#
# Miscellaneous I2C chip drivers configuration
#
# *** DEPRECATED! Do not add new entries! See Makefile ***
#

menu "Miscellaneous I2C Chip support II"


endmenu
```

## net/bluetooth/hidbrcm/Kconfig
```kconfig
config BT_HID_BRCM
	tristate "BRCM HID support"
	depends on BT
	help
	  Say Y here to BRCM HID support into the kernel or say M to
	  compile it as module (bthid).
```

## net/bluetooth/rfcomm/Kconfig
```kconfig
config BT_RFCOMM
	tristate "RFCOMM protocol support"
	depends on BT && BT_L2CAP
	help
	  RFCOMM provides connection oriented stream transport.  RFCOMM
	  support is required for Dialup Networking, OBEX and other Bluetooth
	  applications.

	  Say Y here to compile RFCOMM support into the kernel or say M to
	  compile it as module (rfcomm).

config BT_RFCOMM_TTY
	tristate "RFCOMM TTY support"
	help
	  This option enables TTY emulation support for RFCOMM channels.
```
